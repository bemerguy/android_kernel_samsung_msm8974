## kernel/Kconfig.hz
```kconfig
#
# Timer Interrupt Frequency Configuration
#

config HZ
        int "How many interrupts per second"
        range 100 1000

config SCHED_HRTICK
	def_bool HIGH_RES_TIMERS && (!SMP || USE_GENERIC_SMP_HELPERS)
```
